## boards/shields/x_nucleo_wb05kn1/Kconfig.defconfig
```kconfig
# Copyright (c) 2024 STMicroelectronics
# SPDX-License-Identifier: Apache-2.0

if SHIELD_X_NUCLEO_WB05KN1_UART || SHIELD_X_NUCLEO_WB05KN1_SPI

if BT

config SPI
	default y
	depends on SHIELD_X_NUCLEO_WB05KN1_SPI

config SPI_STM32_INTERRUPT
	default y
	depends on SPI

choice BT_HCI_BUS_TYPE
	default BT_SPI if DT_HAS_ST_HCI_SPI_V2_ENABLED
	default BT_H4
endchoice

config BT_BLUENRG_ACI
	default y

# Disable Flow control
config BT_HCI_ACL_FLOW_CONTROL
	default n

endif # BT

endif # SHIELD_X_NUCLEO_WB05KN1_UART || SHIELD_X_NUCLEO_WB05KN1_SPI
```

## drivers/video/sensor/Kconfig
```kconfig
# SPDX-License-Identifier: Apache-2.0

# zephyr-keep-sorted-start
source "drivers/video/sensor/Kconfig.mt9m114"
source "drivers/video/sensor/Kconfig.ov2640"
source "drivers/video/sensor/Kconfig.ov5640"
source "drivers/video/sensor/Kconfig.ov7725"
# zephyr-keep-sorted-stop
```

## dts/bindings/clock/renesas,ra2a1-clock.yaml
```yaml
# Copyright (c) 2024 TOKITA Hiroshi
# SPDX-License-Identifier: Apache-2.0

description: Renesas RA2A1 Clock Generation Circuit

compatible: "renesas,ra2a1-clock"

include: [clock-controller.yaml, base.yaml]

properties:
  sysclock-source:
    type: int
    required: true
  iclk-div:
    type: int
    required: true
  pclkb-div:
    type: int
    required: true
  pclkd-div:
    type: int
    required: true
  fclk-div:
    type: int
    required: true
  sdclk-out:
    type: int
    required: true

  sdadcclk-source:
    type: int
    required: true
  sdadcclk-div:
    type: int
    required: true

  clkout-source:
    type: int
    required: true
  clkout-div:
    type: int
    required: true
```

## dts/bindings/i2s/espressif,esp32-i2s.yaml
```yaml
description: ESP32 I2S

compatible: "espressif,esp32-i2s"

include: [i2s-controller.yaml, pinctrl-device.yaml]

properties:
  reg:
    required: true

  pinctrl-0:
    required: true

  pinctrl-names:
    required: true

  interrupts:
    required: true

  mclk-enabled:
    type: boolean
    description: |
      Master Clock Output function.
      An mck pin must be listed within pinctrl-0 when enabling this property.
```

## dts/bindings/mtd/st,stm32-nv-flash.yaml
```yaml
description: |
  STM32 flash memory. This binding is for the flash memory itself, not
  the flash controller peripheral. For that, see the
  "st,stm32-flash-controller" binding.

include: soc-nv-flash.yaml

compatible: st,stm32-nv-flash

properties:
  max-erase-time:
    type: int
    description: max erase time(millisecond) of a flash sector or page or half-page
    required: true
  bank2-flash-size:
    type: int
    description: |
      This property defines the size in KB of the embedded flash memory bank2. This
      is needed since M4 CPU to which bank2 is allocated doesn't have access to flash
      controller register to read the size. This provides a way to configure this
      size when the flash controller driver runs on the M4 CPU.
```

## kernel/Kconfig.init
```kconfig
config PLATFORM_EARLY_INIT
	bool "Run early platform hook"
	help
	  Run an early platform initialization hook.

config PLATFORM_LATE_INIT
	bool "Run late platform hook"
	help
	  Run a late platform initialization hook.
```

## samples/drivers/spi_nand/sample.yaml
```yaml
sample:
  name: SPI Flash Sample
tests:
  sample.drivers.spi.flash:
    tags: spi nand
    filter: dt_compat_enabled("jedec,spi-nand")
    harness: console
    harness_config:
        type: multi_line
        ordered: true
        regex:
            - "Test 1: Flash erase"
            - "Flash erase succeeded!"
            - "Test 2: Flash write"
            - "Attempting to write 4 bytes"
            - "Data read matches data written. Good!!"
    depends_on: spi
  sample.drivers.spi.flash_dpd:
    tags: spi nand
    filter: dt_compat_enabled("jedec,spi-nand")
    build_only: true
    extra_configs:
      - CONFIG_SPI_NOR_IDLE_IN_DPD=y
    depends_on: spi
```

## samples/subsys/ipc/ipc_service/icmsg/sample.yaml
```yaml
sample:
  name: IPC Service example integration (icmsg backend)
tests:
  sample.ipc.icmsg:
    platform_allow: nrf5340dk/nrf5340/cpuapp
    integration_platforms:
      - nrf5340dk/nrf5340/cpuapp
    tags: ipc
    sysbuild: true
    harness: remote

  sample.ipc.icmsg.nrf54l15:
    platform_allow: nrf54l15pdk/nrf54l15/cpuapp
    integration_platforms:
      - nrf54l15pdk/nrf54l15/cpuapp
    tags: ipc
    extra_args:
      icmsg_SNIPPET=nordic-flpr
    sysbuild: true
    harness: remote

  sample.ipc.icmsg.nrf54l15_no_multithreading:
    platform_allow: nrf54l15pdk/nrf54l15/cpuapp
    integration_platforms:
      - nrf54l15pdk/nrf54l15/cpuapp
    tags: ipc
    extra_args:
      icmsg_SNIPPET=nordic-flpr
      icmsg_CONFIG_MULTITHREADING=n
      icmsg_CONFIG_LOG=n
      remote_CONFIG_MULTITHREADING=n
      remote_CONFIG_LOG=n
    sysbuild: true
    harness: remote
```

## soc/arm/rpi_pico/rp2/Kconfig.soc
```kconfig
# Raspberry Pi RP2XXX MCU line

# Copyright (c) 2021 Nordic Semiconductor ASA
# Copyright (c) 2021 Yonatan Schachter
# SPDX-License-Identifier: Apache-2.0

choice
	prompt "RP2xxx MCU Selection"
	depends on SOC_SERIES_RP2XXX

config SOC_RP2040
	bool "Raspberry Pi RP2040"

endchoice

config RP2_REQUIRES_SECOND_STAGE_BOOT
	bool
	default y if FLASH_LOAD_OFFSET = 0x100

# Flash type used by the SoC. The board should select the one used.

config RP2_FLASH_W25Q080
	bool
	help
	  Configure RP2 to use a W25Q080 flash chip, or similar. Should be selected
	  by the board definition, not the user.

config RP2_FLASH_GENERIC_03H
	bool
	help
	  Configure RP2 to use a flash chip supporting the standard 03h command.
	  Should be selected by the board definition, not the user.

config RP2_FLASH_IS25LP080
	bool
	help
	  Configure RP2 to use a IS25LP080 flash chip, or similar. Should be selected
	  by the board definition, not the user.

config RP2_FLASH_W25X10CL
	bool
	help
	  Configure RP2 to use a W25X10CL flash chip, or similar. Should be selected
	  by the board definition, not the user.

config RP2_FLASH_AT25SF128A
	bool
	help
	  Configure RP2 to use a AT25SF128A flash chip, or similar. Should be selected
	  by the board definition, not the user.
config RP2_BINARY_INFO
	bool "Generate RaspberryPi Pico binary info"
	default y
	help
	  Binary info is able to embed machine readable information with the binary in FLASH.
	  It can read with picotool(https://github.com/raspberrypi/picotool).

config RP2_BINARY_INFO_RP_PROGRAM_BUILD_DATE_OVERRIDE
	bool "Override build date in binary info"
	help
	  Override RP_PROGRAM_BUILD_DATE_STRING field of binary info
	  by RP2_BINARY_INFO_RP_PROGRAM_BUILD_DATE value.
	  If not specified, set the value of __DATE__ macro to the field.

config RP2_BINARY_INFO_RP_PROGRAM_BUILD_DATE
	string "Override string for build date in binary info"
	depends on RP2_BINARY_INFO_RP_PROGRAM_BUILD_DATE_OVERRIDE

config RP2_BINARY_INFO_RP_PROGRAM_NAME_OVERRIDE
	bool "Override program name in binary info"
	help
	  Override RP_PROGRAM_NAME field of binary info
	  by RP2_BINARY_INFO_RP_PROGRAM_NAME value.
	  If not specified, set the directory name of the project to the field.

config RP2_BINARY_INFO_RP_PROGRAM_NAME
	string "Override string for program name in binary info"
	depends on RP2_BINARY_INFO_RP_PROGRAM_NAME_OVERRIDE

config RP2_BINARY_INFO_RP_PICO_BOARD_OVERRIDE
	bool "Override board in binary info"
	help
	  Override RP_PICO_BOARD field of binary info
	  by RP2_BINARY_INFO_RP_PICO_BOARD value.
	  If not specified, set the 'CONFIG_BOARD' value to this field.

config RP2_BINARY_INFO_RP_PICO_BOARD
	string "Override string for board in binary info"
	depends on RP2_BINARY_INFO_RP_PICO_BOARD_OVERRIDE

config RP2_BINARY_INFO_RP_SDK_VERSION_STRING_OVERRIDE
	bool "Override sdk version in binary info"
	help
	  Override RP_SDK_VERSION field of binary info
	  by RP2_BINARY_INFO_SDK_VERSION_STRING value.
	  If not specified, set the SDK version defined in the pico-sdk to the field.

config RP2_BINARY_INFO_RP_SDK_VERSION_STRING
	string "Override string for sdk version in binary info"
	depends on RP2_BINARY_INFO_RP_SDK_VERSION_STRING_OVERRIDE

config RP2_BINARY_INFO_RP_PROGRAM_VERSION_STRING_OVERRIDE
	bool "Override program version in binary info"
	help
	  Override RP_PROGRAM_VERSION_STRING field of binary info
	  by RP2_BINARY_INFO_RP_PROGRAM_VERSION_STRING value.
	  If not specified, set the zephyr's BUILD_VERSION definition to the field.

config RP2_BINARY_INFO_RP_PROGRAM_VERSION_STRING
	string "Override string for program version in binary info"
	depends on RP2_BINARY_INFO_RP_PROGRAM_VERSION_STRING_OVERRIDE

config RP2_BINARY_INFO_RP_PROGRAM_DESCRIPTION_OVERRIDE
	bool "Override program descrpition in binary info"
	help
	  Override RP_PROGRAM_DESCRIPTION field of binary info
	  by RP2_BINARY_INFO_RP_PROGRAM_DESCRIPTION value.
	  If not specified, set an empty string to the field.

config RP2_BINARY_INFO_RP_PROGRAM_DESCRIPTION
	string "String for program description in binary info"

config RP2_BINARY_INFO_RP_PROGRAM_URL_OVERRIDE
	bool "Override program url in binary info"
	help
	  Override RP_PROGRAM_URL field of binary info
	  by RP2_BINARY_INFO_RP_PROGRAM_URL value.
	  If not specified, set an empty string to the field.

config RP2_BINARY_INFO_RP_PROGRAM_URL
	string "String for program description in binary info"
```

## soc/nxp/mcx/mcxn23x/Kconfig
```kconfig
# Copyright 2024 NXP
# SPDX-License-Identifier: Apache-2.0

config SOC_SERIES_MCXN23X
	select HAS_MCUX
	select HAS_MCUX_FLEXCOMM
	select CPU_CORTEX_M_HAS_SYSTICK
	select CPU_CORTEX_M_HAS_DWT
	select PLATFORM_SPECIFIC_INIT

config SOC_MCXN236
	select CPU_CORTEX_M33
	select CPU_HAS_ARM_SAU
	select CPU_HAS_ARM_MPU
	select CPU_HAS_FPU
	select ARMV8_M_DSP
	select ARM_TRUSTZONE_M
	select HAS_MCUX_CACHE

if SOC_SERIES_MCXN23X

DT_CHOSEN_Z_FLASH := zephyr,flash
DT_COMPAT_FLEXSPI := nxp,imx-flexspi

DT_CHOSEN_FLASH_NODE := $(dt_chosen_path,$(DT_CHOSEN_Z_FLASH))
DT_CHOSEN_FLASH_PARENT := $(dt_node_parent,$(DT_CHOSEN_FLASH_NODE))

DT_FLASH_PARENT_IS_FLEXSPI := $(dt_node_has_compat,$(DT_CHOSEN_FLASH_PARENT),$(DT_COMPAT_FLEXSPI))
DT_FLASH_HAS_SIZE_PROP := $(dt_node_has_prop,$(DT_CHOSEN_FLASH_NODE),size)

config FLASH_BASE_ADDRESS
	default $(dt_node_reg_addr_hex,$(DT_CHOSEN_FLASH_PARENT),1) \
		if $(DT_FLASH_PARENT_IS_FLEXSPI)

config FLASH_SIZE
	default $(dt_node_int_prop_int,$(DT_CHOSEN_FLASH_NODE),size,Kb) \
		if $(DT_FLASH_HAS_SIZE_PROP)

endif # SOC_SERIES_MCXN23X
```

## soc/nxp/mcx/mcxn23x/Kconfig.soc
```kconfig
# Copyright 2024 NXP
# SPDX-License-Identifier: Apache-2.0

config SOC_SERIES_MCXN23X
	bool
	select SOC_FAMILY_NXP_MCX

config SOC_SERIES
	default "mcxn23x" if SOC_SERIES_MCXN23X

config SOC_MCXN236
	bool
	select SOC_SERIES_MCXN23X

config SOC
	default "mcxn236" if SOC_MCXN236

config SOC_PART_NUMBER_MCXN236VDF
	bool

config SOC_PART_NUMBER_MCXN236VNL
	bool

config SOC_PART_NUMBER
	default "MCXN236VDF" if SOC_PART_NUMBER_MCXN236VDF
	default "MCXN236VNL" if SOC_PART_NUMBER_MCXN236VNL
```

## soc/renesas/ra/common/Kconfig
```kconfig
config SOC_OPTION_SETTING_MEMORY
        bool "Option Setting Memory"
        default y
```

## soc/renesas/ra/ra2a1/Kconfig
```kconfig
# Copyright (c) 2024 TOKITA Hiroshi <tokita.hiroshi@fujitsu.com>
# SPDX-License-Identifier: Apache-2.0

config SOC_SERIES_RA2A1
	select ARM
	select CPU_CORTEX_M23
	select CPU_HAS_ARM_MPU
	select CPU_CORTEX_M_HAS_VTOR
	select CPU_CORTEX_M_HAS_SYSTICK
	select DYNAMIC_INTERRUPTS
	select TIMER_READS_ITS_FREQUENCY_AT_RUNTIME
	select XIP

config SOC_OPTION_SETTING_MEMORY
	bool "Option Setting Memory"
	default y

config SOC_OPTION_SETTING_LVDAS_DISABLE
	bool "Disable voltage monitor 0 after reset"
	default y
	depends on SOC_OPTION_SETTING_MEMORY

config SOC_OPTION_SETTING_HOCO_DISABLE
	bool "Disable HOCO oscillator after reset"
	depends on SOC_OPTION_SETTING_MEMORY

config SOC_OPTION_SETTING_HOCO_FREQ
	int "HOCO oscillator frequency"
	default $(dt_node_int_prop_int,/clocks/hoco,clock-frequency)
	depends on SOC_OPTION_SETTING_MEMORY

config SOC_OPTION_SETTING_VDSEL
	int "Voltage Detection 0 Level Select"
	default 1900
	depends on SOC_OPTION_SETTING_MEMORY
```

## soc/wch/ch32v/Kconfig.soc
```kconfig
# Copyright (c) 2023-2024 Chen Xingyu <hi@xingrz.me>
# SPDX-License-Identifier: Apache-2.0

config SOC_FAMILY_CH32V
	bool
	select RISCV
	select RISCV_PRIVILEGED
	select INCLUDE_RESET_VECTOR
	select ATOMIC_OPERATIONS_C

config SOC_FAMILY
	default "ch32v" if SOC_FAMILY_CH32V

rsource "*/Kconfig.soc"
```

## soc/wch/ch32v/qingke_v3/Kconfig.defconfig.ch56x
```kconfig
# Copyright (c) 2023-2024 Chen Xingyu <hi@xingrz.me>
# SPDX-License-Identifier: Apache-2.0

if SOC_CH565 || SOC_CH569

config NUM_IRQS
	int
	default 256

endif # SOC_CH565 || SOC_CH569
```

## tests/Kconfig.sysbuild
```kconfig
# Copyright (c) 2024 Nordic Semiconductor ASA
# SPDX-License-Identifier: Apache-2.0

# For tests on cpuppr on nrf54h20 we need vpr_launcher application on cpuapp
# which kickstarts cpuppr.
config VPR_LAUNCHER
	default y if BOARD_NRF54H20DK_NRF54H20_CPUPPR
```

## tests/cmake/sysbuild_snippets/Kconfig.sysbuild
```kconfig
# Copyright 2024 Nordic Semiconductor ASA
# SPDX-License-Identifier: Apache-2.0

config TEST_FOO_VAL
	int "Test value"
	default 0
	help
	  This option's value should be overridden by the 'foo' snippet config
	  overlay.

source "${ZEPHYR_BASE}/share/sysbuild/Kconfig"
```

## tests/cmake/sysbuild_snippets/testcase.yaml
```yaml
common:
  sysbuild: true
  tags: sysbuild_snippets sysbuild
  platform_allow:
  - native_sim
  integration_platforms:
  - native_sim

tests:
  # Test the initial state with no snippets applied
  buildsystem.sysbuild.snippets.none:
    extra_args:
    - TEST_VALUE=0
  # Test the `foo` snippet in sysbuild
  buildsystem.sysbuild.snippets.applied:
    extra_args:
    - sysbuild_SNIPPET=foo
    - TEST_VALUE=464372
```

## tests/kernel/mem_slab/mslab/Kconfig
```kconfig
# Copyright (c) 2023 Intel Corporation
# SPDX-License-Identifier: Apache-2.0

source "Kconfig.zephyr"

config TEST_ALLOC_TIMEOUT_MS
	int "Test with k_mem_slab_alloc() timeout."
	default 50
	help
	  Use as k_mem_slab_alloc() timeout for the tests.
	  Adjust to platform performance if needed.
```

## tests/lib/app_version/git_tweak/testcase.yaml
```yaml
tests:
  libraries.app_version.git_tweak:
    tags: version
    integration_platforms:
      - native_sim
```
