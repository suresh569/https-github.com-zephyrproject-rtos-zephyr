## prj.conf
```kconfig
CONFIG_POSIX_API=y
CONFIG_ZTEST=y

# for POSIX_FILESYSTEM
CONFIG_POSIX_FILE_SYSTEM=y

# for _POSIX_SYNCHRONIZED_IO
CONFIG_POSIX_SYNCHRONIZED_IO=y

# for networking things to work
CONFIG_NETWORKING=y
CONFIG_POSIX_NETWORKING=y
CONFIG_NET_TEST=y
CONFIG_TEST_RANDOM_GENERATOR=y

# For e.g. sched_get_priority_max()
CONFIG_POSIX_PRIORITY_SCHEDULING=y

# For putmsg(), etc
CONFIG_XOPEN_STREAMS=y

# for when CONFIG_POSIX_API is not selected
CONFIG_POSIX_THREADS=y
CONFIG_POSIX_TIMERS=y
CONFIG_POSIX_MESSAGE_PASSING=y
CONFIG_EVENTFD=y
CONFIG_POSIX_C_LIB_EXT=y
```

## src/dirent_h.c
```c
/*
 * Copyright (c) 2022 Meta
 *
 * SPDX-License-Identifier: Apache-2.0
 */

#include "_common.h"

#ifdef CONFIG_POSIX_API
#include <dirent.h>
#else
#include <zephyr/posix/dirent.h>
#endif

/**
 * @brief existence test for `<dirent.h>`
 *
 * @see <a href="https://pubs.opengroup.org/onlinepubs/9699919799/basedefs/dirent.h.html">dirent.h</a>
 */
ZTEST(posix_headers, test_dirent_h)
{
#ifdef CONFIG_POSIX_API
	zassert_not_equal((DIR *)-1, (DIR *)NULL);

	zassert_not_equal(-1, offsetof(struct dirent, d_ino));
	zassert_not_equal(-1, offsetof(struct dirent, d_name));

	/* zassert_not_null(alphasort); */ /* not implemented */
	zassert_not_null(closedir);
	/* zassert_not_null(dirfd); */     /* not implemented */
	/* zassert_not_null(fdopendir); */ /* not implemented */
	zassert_not_null(opendir);
	zassert_not_null(readdir);
#ifdef CONFIG_POSIX_THREAD_SAFE_FUNCTIONS
	zassert_not_null(readdir_r);
#endif
	/* zassert_not_null(rewinddir); */ /* not implemented */
	/* zassert_not_null(scandir); */   /* not implemented */
	/* zassert_not_null(seekdir); */   /* not implemented */
	/* zassert_not_null(telldir); */   /* not implemented */
#endif
}
```
