/*
 * Copyright (c) 2024 TOKITA Hiroshi
 *
 * SPDX-License-Identifier: Apache-2.0
 */

#include <arm/renesas/ra/ra2/r7fa2a1xh.dtsi>

&flash0 {
	reg = <0x00000000 DT_SIZE_K(256)>;
};

&flash1 {
	reg = <0x40100000 DT_SIZE_K(8)>;
};
