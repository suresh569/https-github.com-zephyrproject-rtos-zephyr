## CMakeLists.txt
```
# Copyright (c) 2024 Syslinbit SCOP SAS
# SPDX-License-Identifier: Apache-2.0

cmake_minimum_required(VERSION 3.20.0)
find_package(Zephyr REQUIRED HINTS $ENV{ZEPHYR_BASE})
project(usb-host-shell)

FILE(GLOB app_sources src/*.c)
target_sources(app PRIVATE ${app_sources})
```

## sample.yaml
```
sample:
  name: USB host support shell sample
tests:
  sample.usbh.shell:
    platform_allow:
      - nucleo_h723zg
    depends_on: usb_host
    harness: keyboard
    tags: usb
```

## prj.conf
```kconfig
CONFIG_SHELL=y

CONFIG_UHC_DRIVER=y

CONFIG_USB_HOST_STACK=y
CONFIG_USBH_SHELL=y

CONFIG_LOG=y
CONFIG_USBH_LOG_LEVEL_WRN=y
CONFIG_UHC_DRIVER_LOG_LEVEL_WRN=y
```

## boards/nucleo_h723zg.conf
```kconfig
CONFIG_UHC_STM32=y
```

## boards/nucleo_h723zg.overlay
```dts
/*
 * Copyright (c) 2024 Syslinbit SCOP SAS
 *
 * SPDX-License-Identifier: Apache-2.0
 */

zephyr_uhc0: &usbotg_hs {
	pinctrl-0 = <&usb_otg_hs_dm_pa11 &usb_otg_hs_dp_pa12>;
	pinctrl-names = "default";
	vbus-gpios = <&gpiod 10 GPIO_ACTIVE_LOW>;
	status = "okay";
};
```

## src/main.c
```c
/*
 * Copyright (c) 2024 Syslinbit SCOP SAS
 *
 * SPDX-License-Identifier: Apache-2.0
 */

#include <zephyr/kernel.h>

int main(void)
{
	return 0;
}
```
